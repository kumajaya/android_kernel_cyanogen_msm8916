## drivers/input/touchscreen/gt9xx_pd1510/Kconfig
```kconfig
#
# Goodix GT9xx Touchscreen driver
#
config TOUCHSCREEN_GT9XX_PD1510
	bool "Goodix touchpanel GT9xx series (Vivo PD1510 variant)"
	depends on I2C
	help
	  Say Y here if you have a Goodix GT9xx touchscreen
	  controller.

          If unsure, say N.

config TOUCHSCREEN_GT9XX_PD1510_UPDATE
	tristate "Goodix GT9xx touch controller (Vivo PD1510 variant) auto update support"
	depends on TOUCHSCREEN_GT9XX
	default y
	help
	  Enable this for support firmware update.

	  Say Y here if you want update touch controller firmware.

	  If unsure, say N.

config TOUCHSCREEN_GT9XX_PD1510_TOOL
	tristate "Goodix GT9xx (Vivo PD1510 variant) Tools for debuging"
	depends on TOUCHSCREEN_GT9XX
	default y
	help
	  This implement interface support for Goodix GT9xx
	  touchscreen debug.

	  Say Y here if you want to have a Android app debug interface
	  to your system.

	  If unsure, say N.
```

## drivers/misc/hscdtd00x/Kconfig
```kconfig
menu  "ALPS geomagnetic sensor support"
config SENSORS_HSCDTD007A
	depends on I2C && INPUT_POLLDEV
	tristate "ALPS geomagnetic sensor HSCDTD007/HSCDTD008"
	default n
        help
		This option enables hscd alps HSCDTD007a
		magnetometer driver.

		If you say yes, you will get support for
		HSCDTD007 and HSCDTD008.
endmenu
```

## drivers/platform/vivo/Kconfig
```kconfig
# Vivo configuration options

config MACH_VIVO
	bool "Vivo device"
	depends on ARCH_MSM
	help
	  Support for Vivo products

config MACH_VIVO_MSM8916
	bool "Vivo MSM8916"
	depends on ARCH_MSM8916
	select MACH_VIVO
	help
	  Support for MSM8916 Vivo variants

menu "Vivo board selection"

config MACH_PD1510
	bool "PD1510 board"
	select MACH_VIVO_MSM8916
	help
	  Support for Vivo PD1510 variant

endmenu
```
